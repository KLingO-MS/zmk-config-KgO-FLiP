## boards/shields/FLiP/Kconfig.defconfig
```kconfig
# Copyright (c) 2021 The ZMK Contributors
# SPDX-License-Identifier: MIT

if SHIELD_FLIP_LEFT

config ZMK_KEYBOARD_NAME
    default "FLiP"

config ZMK_SPLIT_ROLE_CENTRAL
    default y

endif

if SHIELD_FLIP_LEFT || SHIELD_FLIP_RIGHT

config ZMK_SPLIT
    default y

config ZMK_BATTERY_REPORTING
    default n

endif
```

## boards/shields/FLiP/Kconfig.shield
```kconfig
# Copyright (c) 2021 The ZMK Contributors
# SPDX-License-Identifier: MIT

config SHIELD_FLIP_LEFT
    def_bool $(shields_list_contains,FLiP_left)

config SHIELD_FLIP_RIGHT
    def_bool $(shields_list_contains,FLiP_right)
```

## boards/shields/Rommana/Kconfig.defconfig
```kconfig
# Copyright (c) 2021 The ZMK Contributors
# SPDX-License-Identifier: MIT

if SHIELD_ROMMANA_LEFT

config ZMK_KEYBOARD_NAME
    default "Rommana"

config ZMK_SPLIT_ROLE_CENTRAL
    default y

endif

if SHIELD_ROMMANA_LEFT || SHIELD_ROMMANA_RIGHT

config ZMK_SPLIT
    default y

config ZMK_BATTERY_REPORTING
    default n

endif
```

## boards/shields/Rommana/Kconfig.shield
```kconfig
# Copyright (c) 2021 The ZMK Contributors
# SPDX-License-Identifier: MIT

config SHIELD_ROMMANA_LEFT
    def_bool $(shields_list_contains,Rommana_left)

config SHIELD_ROMMANA_RIGHT
    def_bool $(shields_list_contains,Rommana_right)
```
