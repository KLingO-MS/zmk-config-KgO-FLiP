## boards/shields/Boulder/Kconfig.defconfig
```kconfig
# Copyright (c) 2021 The ZMK Contributors
# SPDX-License-Identifier: MIT

if SHIELD_BOULDER_LEFT

config ZMK_KEYBOARD_NAME
    default "Boulder"

config ZMK_SPLIT_ROLE_CENTRAL
    default y

endif

if SHIELD_BOULDER_LEFT || SHIELD_BOULDER_RIGHT

config ZMK_SPLIT
    default y

config ZMK_BATTERY_REPORTING
    default n

endif
```

## boards/shields/Boulder/Kconfig.shield
```kconfig
# Copyright (c) 2021 The ZMK Contributors
# SPDX-License-Identifier: MIT

config SHIELD_BOULDER_LEFT
    def_bool $(shields_list_contains,Boulder_left)

config SHIELD_BOULDER_RIGHT
    def_bool $(shields_list_contains,Boulder_right)
```

## config/west.yml
```yaml
manifest:
  defaults:
    revision: v0.1 # version to use for this module and for ZMK
  remotes:
    - name: zmkfirmware
      url-base: https://github.com/zmkfirmware
    - name: urob
      url-base: https://github.com/urob
  projects:
    - name: zmk
      remote: zmkfirmware
      revision: main
      import: app/west.yml
    - name: zmk-adaptive-key
      remote: urob
#    - name: zmk-leader-key
#      remote: urob
  self:
    path: config
```
